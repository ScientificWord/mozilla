<?xul-overlay href="chrome://prince/content/msiEditorContextMenuOverlay.xul"?>
<?xul-overlay href="chrome://global/content/globalOverlay.xul"?>
<?xul-overlay href="chrome://prince/content/menuOverlay.xul" ?>
##<?xul-overlay href="chrome://prince/content/basemenuOverlay.xul" ?>
<?xul-overlay href="chrome://prince/content/toolbarsOverlay.xul" ?>
<?xul-overlay href="chrome://prince/content/MathmlOverlay.xul" ?>
<?xul-overlay href="chrome://cascades/content/cascadesOverlay.xul" ?>

#ifdef PROD_SWP
<?xul-overlay href="chrome://prince/content/computeOverlay.xul" ?>
<?xul-overlay href="chrome://prince/content/vcamoverlay.xul" ?>
<?xul-overlay href="chrome://prince/content/typesetOverlay.xul" ?>
#endif

#ifdef PROD_SNB
<?xul-overlay href="chrome://prince/content/computeOverlay.xul" ?>
<?xul-overlay href="chrome://prince/content/vcamoverlay.xul" ?>
#endif

#ifdef PROD_SW
<?xul-overlay href="chrome://prince/content/typesetOverlay.xul" ?>
#endif
