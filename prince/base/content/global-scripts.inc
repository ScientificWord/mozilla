<script type="application/x-javascript" src="chrome://prince/content/prince.js"/>
<script type="application/x-javascript" src="chrome://prince/content/msiEditorDefinitions.js"/>
<script type="application/x-javascript" src="chrome://prince/content/msiEditor.js"/>
<script type="application/x-javascript" src="chrome://prince/content/msiMainEditor.js"/>
<script type="application/x-javascript" src="chrome://prince/content/msiEditorUtilities.js"/>
<script type="application/x-javascript" src="chrome://prince/content/msiDialogUtilities.js"/>
<script type="application/x-javascript" src="chrome://prince/content/msiComposerCommands.js"/>
<script type="application/x-javascript" src="chrome://prince/content/fastcursor.js"/>
<script type="application/x-javascript" src="chrome://editor/content/EditorCommandsDebug.js"/>
<script type="application/x-javascript" src="chrome://prince/content/msiEditorCommandsDebug.js"/>
<script type="application/x-javascript" src="chrome://global/content/viewZoomOverlay.js"/>
<script type="application/x-javascript" src="chrome://prince/content/RealTimeSpell.js"/>
<script type="application/x-javascript" src="chrome://prince/content/fragment.js"/>
<script type="application/x-javascript" src="chrome://global/content/nsTransferable.js"/>
<script type="application/x-javascript" src="chrome://global/content/nsDragAndDrop.js"/>
<script type="application/x-javascript" src="chrome://global/content/printUtils.js"/>
<script type="application/x-javascript" src="chrome://venkman/content/venkman-overlay.js"/>
<script type="application/x-javascript" src="chrome://user/content/macros.js"/>
<script type="application/x-javascript" src="chrome://prince/content/saveforweb.js"/>
<script type="application/x-javascript" src="chrome://prince/content/computeOverlay.js"/>
<script type="application/x-javascript" src="chrome://prince/content/msiEditorApplicationOverlay.js"/>
<script type="application/x-javascript" src="chrome://prince/content/mainCore.js" />
<script type="application/x-javascript" src="chrome://inspector/content/jsutil/xul/DNDUtils.js" />
<script type="application/x-javascript" src="chrome://inspector/content/jsutil/xpcom/XPCU.js" />
