<script type="application/x-javascript" src="chrome://prince/content/msiEditorUtilities.js"/>
<script type="application/x-javascript" src="chrome://prince/content/msiDialogUtilities.js"/>
<script type="application/x-javascript" src="chrome://prince/content/msiEdDialogCommon.js"/>
<script type="application/x-javascript" src="chrome://prince/content/msiEditorDefinitions.js"/>
<script type="application/x-javascript" src="chrome://prince/content/msiEditor.js"/>
<script type="application/x-javascript" src="chrome://prince/content/msiComposerCommands.js"/>
<script type="application/x-javascript" src="chrome://prince/content/msiMainEditor.js" />
<script type="application/x-javascript" src="chrome://prince/content/msiEditorApplicationOverlay.js"/>
<script type="application/x-javascript" src="chrome://prince/content/realTimeSpell.js"/>
<script type="application/x-javascript" src="chrome://user/content/macros.js"/>
