<!DOCTYPE window [
<!ENTITY % editorDTD SYSTEM "chrome://editor/locale/editor.dtd" >
%editorDTD;
<!ENTITY % editorOverlayDTD SYSTEM "chrome://editor/locale/editorOverlay.dtd" >
%editorOverlayDTD;
<!ENTITY % mathmlOverlayDTD SYSTEM "chrome://editor/locale/MathmlOverlay.dtd" >
%mathmlOverlayDTD;
<!ENTITY % computeOverlayDTD SYSTEM "chrome://editor/locale/ComputeOverlay.dtd" >
%computeOverlayDTD;
<!ENTITY % brandDTD SYSTEM "chrome://global/locale/brand.dtd" >
%brandDTD;
<!ENTITY % fastcursorDTD SYSTEM "chrome://editor/locale/fastcursor.dtd" >
%fastcursorDTD;
<!ENTITY % princetoolbarsDTD SYSTEM "chrome://editor/locale/princetoolbarsOverlay.dtd" >
%princetoolbarsDTD;
]> 
